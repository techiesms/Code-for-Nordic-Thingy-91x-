/*
 * Copyright (c) 2021 Bosch Sensortec GmbH
 *
 * SPDX-License-Identifier: Apache-2.0
 */

&spi3 {
    status = "okay";
    bmi270: bmi270@2 {
        compatible = "bosch,bmi270";
        reg = <2>;
        spi-max-frequency = <5000000>;
        status = "okay";
    };
};

