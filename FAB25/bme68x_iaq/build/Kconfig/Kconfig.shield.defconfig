## FAB25/bme68x_iaq/build/Kconfig/Kconfig.shield.defconfig
```kconfig
osource "C:/FAB25/bme68x_iaq/boards/shields/*/Kconfig.defconfig"
osource "C:/ncs/v3.0.0/nrf/boards/shields/*/Kconfig.defconfig"
```

## FAB25/bme68x_iaq/build/bme68x_iaq/Kconfig/Kconfig.shield
```kconfig
osource "C:/FAB25/bme68x_iaq/boards/shields/*/Kconfig.shield"
osource "C:/ncs/v3.0.0/nrf/boards/shields/*/Kconfig.shield"
```

## FAB25/bme68x_iaq/build/bme68x_iaq/Kconfig/boards/Kconfig.thingy91x
```kconfig
# Load board Kconfig descriptions.
osource "C:/ncs/v3.0.0/nrf/boards/nordic/thingy91x/Kconfig.thingy91x"
```

## FAB25/gnss/build/Kconfig/boards/Kconfig
```kconfig
# Load Zephyr board Kconfig descriptions.
osource "C:/ncs/v2.9.1/nrf/boards/nordic/thingy91x/Kconfig"
```

## FAB25/gnss/build/Kconfig/boards/Kconfig.defconfig
```kconfig
# Load Zephyr board defconfig descriptions.
osource "C:/ncs/v2.9.1/nrf/boards/nordic/thingy91x/Kconfig.defconfig"
```

## FAB25/rgb_led/build/Kconfig/Kconfig.shield
```kconfig
osource "C:/nordic/myApps/rgb_led/boards/shields/*/Kconfig.shield"
osource "C:/ncs/v2.9.1/nrf/boards/shields/*/Kconfig.shield"
```

## FAB25/rgb_led/build/Kconfig/boards/Kconfig.thingy91x
```kconfig
# Load board Kconfig descriptions.
osource "C:/ncs/v2.9.1/nrf/boards/nordic/thingy91x/Kconfig.thingy91x"
```

## FAB25/rgb_led/build/b0/Kconfig/Kconfig.shield.defconfig
```kconfig
osource "C:/nordic/myApps/rgb_led/boards/shields/*/Kconfig.defconfig"
osource "C:/ncs/v2.9.1/nrf/boards/shields/*/Kconfig.defconfig"
```
